## wksfile.wks
```
part /boot --source bootimg-partition --ondisk mmcblk0 --fstype=vfat --label boot --active --align 4 --size 1G
part / --source rootfs --ondisk mmcblk0 --fstype=ext4 --label root --align 4 --size 1G
```
